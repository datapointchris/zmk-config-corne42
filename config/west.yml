## config/west.yml
```yaml
manifest:
  remotes:
    - name: zmkfirmware
      url-base: https://github.com/zmkfirmware
    - name: datapointchris
      url-base: https://github.com/datapointchris
  projects:
    - name: zmk
      remote: zmkfirmware
      revision: main
      import: app/west.yml
    - name: zmk-shared
      remote: datapointchris
      revision: main
  self:
    path: config
```
